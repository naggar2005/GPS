#include "TM4C123.h"
#include "bit_utilies.h"

//uart initialization
void uart_init()
{
	SET_BIT( SYSCTL_RCGCUART_R ,0); //CLOCK-->UART2
	while(GET_BIT(SYSCTL_PRUART_R,0)==0);// until uart2 activate
	SET_BIT(SYSCTL_RCGCGPIO_R,0);  //CLOCK-->PORTD
	while(GET_BIT(SYSCTL_PRGPIO_R,0)==0);
	CLR(UART0_CTL_R,UART_CTL_UARTEN); //DISABLE UART
	UART0_IBRD_R=104;
	UART0_FBRD_R=11;
	SET(UART0_LCRH_R,UART_LCRH_WLEN_8);//WORDLENGTH=8
	SET(UART0_LCRH_R,UART_LCRH_FEN);  //FIFO ENABLE
	
	//ENABLE UART TX,RX
	SET(UART0_CTL_R,UART_CTL_UARTEN);  //ENABLE UART
	SET(UART0_CTL_R,UART_CTL_TXE);  //ENABLE TX
	SET(UART0_CTL_R,UART_CTL_RXE);  //ENABLE RX

	//ENABLE GPIO
	SET(GPIO_PORTD_AFSEL_R,0XC0);
	
	//SELECT ALTERNATE FUNCTION TYPE
	CLR(GPIO_PORTA_PCTL_R,0X000000FF);// ALTERNATE FUNCTION FOR PD6,PD7
	SET(GPIO_PORTA_PCTL_R,GPIO_PCTL_PA0_U0RX); //PD6-->RX
	SET(GPIO_PORTA_PCTL_R,GPIO_PCTL_PA1_U0TX); //PD7-->TX
	SET(GPIO_PORTA_DEN_R,0X3);  //PD0,PD1-->DIGITAL
	
}
//CHECK FOR RECIVED CHARACTER
char uart_ischar_available()
	{
		return((UART0_FR_R&UART_FR_RXFE)==UART_FR_RXFE);
	}
	
	//GET character
	char uart_getchar()
	{
		while((UART0_FR_R & UART_FR_RXFE)!=0);
		return (char)GET_REG(UART0_DR_R);
	}
	






